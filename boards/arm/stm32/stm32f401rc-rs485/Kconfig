## boards/arm/stm32/stm32f401rc-rs485/Kconfig
```kconfig
#
# For a description of the syntax of this configuration file,
# see the file kconfig-language.txt in the NuttX tools repository.
#

if ARCH_BOARD_STM32F401RC_RS485

menuconfig STM32F401RC_RS485_HX711
	bool "Enable hx711 scale sensor"
	default n
	select ADC_HX711

if STM32F401RC_RS485_HX711

choice
	prompt "Select GPIO port for clock pin"
	default STM32F401RC_RS485_HX711_CLK_PORTB

config STM32F401RC_RS485_HX711_CLK_PORTA
	bool "Port A"
config STM32F401RC_RS485_HX711_CLK_PORTB
	bool "Port B"

endchoice # Select GPIO port for clock pin

config STM32F401RC_RS485_HX711_CLK_PIN
	int "Select GPIO pin number for clock pin"
	default 1
	range 0 15

choice
	prompt "Select GPIO port for data pin"
	default STM32F401RC_RS485_HX711_DATA_PORTB

config STM32F401RC_RS485_HX711_DATA_PORTA
	bool "Port A"
config STM32F401RC_RS485_HX711_DATA_PORTB
	bool "Port B"

endchoice # Select GPIO port for data pin

config STM32F401RC_RS485_HX711_DATA_PIN
	int "Select GPIO pin number for data pin"
	default 2
	range 0 15

endif # STM32F401RC_RS485_HX711

endif # ARCH_BOARD_STM32F401RC_RS485
```
